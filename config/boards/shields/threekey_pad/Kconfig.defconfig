## config/boards/shields/threekey_pad/Kconfig.defconfig
```kconfig
# Kconfig.defconfig
if SHIELD_THREEKEY_PAD

config ZMK_KEYBOARD_NAME
    default "threekey_pad"

endif
```

## west.yml
```yaml
manifest:
  defaults:
    remote: zmkfirmware

  remotes:
    - name: zmkfirmware
      url-base: https://github.com/zmkfirmware

  projects:
    - name: zmk
      url: https://github.com/zmkfirmware/zmk.git
      revision: main
      import: app/west.yml

    - name: zmkfirmware/zap
      url: https://github.com/zmkfirmware/zap.git
      revision: main

    - path: modules/threekey_pad

  self:
    path: config
```
